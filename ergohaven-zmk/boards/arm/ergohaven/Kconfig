## ergohaven-zmk/boards/arm/ergohaven/Kconfig
```kconfig
config BOARD_ENABLE_DCDC
    bool "Enable DCDC mode"
    select SOC_DCDC_NRF52X
    default y
    depends on (BOARD_ERGOHAVEN)

config BOARD_ERGOHAVEN_CHARGER
    bool "Enable battery charger"
    default y
    depends on (BOARD_ERGOHAVEN)
```

## ergohaven-zmk/boards/arm/ergohaven/Kconfig.board
```kconfig
# ergohaven board configuration

# Copyright (c) 2020 The ZMK Contributors
# SPDX-License-Identifier: MIT

config BOARD_ERGOHAVEN
    bool "ergohaven"
    depends on SOC_NRF52840_QIAA
```

## ergohaven-zmk/boards/arm/ergohaven/Kconfig.defconfig
```kconfig
# Electronut Labs Papyr board configuration

# Copyright (c) 2020 The ZMK Contributors
# SPDX-License-Identifier: MIT

if BOARD_ERGOHAVEN

config BOARD
    default "ergohaven"

if USB_DEVICE_STACK

config USB_NRFX
    default y

endif # USB_DEVICE_STACK

config BT_CTLR
    default BT

config BOARD_ERGOHAVEN_CHARGER
    default n

endif # BOARD_ERGOHAVEN
```

## ergohaven-zmk/boards/shields/k03/Kconfig.defconfig
```kconfig
if SHIELD_K03_QUBE || SHIELD_K03_LEFT

config ZMK_KEYBOARD_NAME
    default "K:03"

config ZMK_SPLIT_ROLE_CENTRAL
    default y

endif

if SHIELD_K03_QUBE || SHIELD_K03_LEFT_QUBE || SHIELD_K03_LEFT || SHIELD_K03_RIGHT

config ZMK_SPLIT
    default y

config ZMK_POINTING
    default y

endif
```

## ergohaven-zmk/boards/shields/k03/Kconfig.shield
```kconfig
config SHIELD_K03_LEFT_QUBE
    def_bool $(shields_list_contains,k03_left_qube)

config SHIELD_K03_QUBE
    def_bool $(shields_list_contains,k03_qube)

config SHIELD_K03_LEFT
    def_bool $(shields_list_contains,k03_left)

config SHIELD_K03_RIGHT
    def_bool $(shields_list_contains,k03_right)
```

## ergohaven-zmk/boards/shields/op36/Kconfig.defconfig
```kconfig
if SHIELD_OP36_QUBE || SHIELD_OP36_LEFT

config ZMK_KEYBOARD_NAME
    default "EH_OP36"

config ZMK_SPLIT_ROLE_CENTRAL
    default y

endif

if SHIELD_OP36_QUBE || SHIELD_OP36_LEFT_QUBE || SHIELD_OP36_LEFT || SHIELD_OP36_RIGHT

config ZMK_SPLIT
    default y

endif
```

## ergohaven-zmk/boards/shields/op36/Kconfig.shield
```kconfig
config SHIELD_OP36_LEFT_QUBE
    def_bool $(shields_list_contains,op36_left_qube)

config SHIELD_OP36_QUBE
    def_bool $(shields_list_contains,op36_qube)

config SHIELD_OP36_LEFT
    def_bool $(shields_list_contains,op36_left)

config SHIELD_OP36_RIGHT
    def_bool $(shields_list_contains,op36_right)
```

## ergohaven-zmk/boards/shields/velvet_v3/Kconfig.defconfig
```kconfig
if SHIELD_VELVET_V3_QUBE || SHIELD_VELVET_V3_LEFT

config ZMK_KEYBOARD_NAME
    default "Velvet_v3"

config ZMK_SPLIT_ROLE_CENTRAL
    default y

endif

if SHIELD_VELVET_V3_QUBE || SHIELD_VELVET_V3_LEFT_QUBE || SHIELD_VELVET_V3_LEFT || SHIELD_VELVET_V3_RIGHT

config ZMK_SPLIT
    default y

endif
```

## ergohaven-zmk/boards/shields/velvet_v3/Kconfig.shield
```kconfig
config SHIELD_VELVET_V3_LEFT_QUBE
    def_bool $(shields_list_contains,velvet_v3_left_qube)

config SHIELD_VELVET_V3_QUBE
    def_bool $(shields_list_contains,velvet_v3_qube)

config SHIELD_VELVET_V3_LEFT
    def_bool $(shields_list_contains,velvet_v3_left)

config SHIELD_VELVET_V3_RIGHT
    def_bool $(shields_list_contains,velvet_v3_right)
```

## ergohaven-zmk/boards/shields/velvet_v3_ui/Kconfig.defconfig
```kconfig
if SHIELD_VELVET_V3_UI_QUBE || SHIELD_VELVET_V3_UI_RIGHT

config ZMK_KEYBOARD_NAME
    default "Velvet_v3_UI"

config ZMK_SPLIT_ROLE_CENTRAL
	default y

config ZMK_POINTING
    default y

endif

if SHIELD_VELVET_V3_UI_QUBE || SHIELD_VELVET_V3_UI_RIGHT_QUBE || SHIELD_VELVET_V3_UI_LEFT || SHIELD_VELVET_V3_UI_RIGHT

config ZMK_SPLIT
    default y

endif
```

## ergohaven-zmk/boards/shields/velvet_v3_ui/Kconfig.shield
```kconfig
config SHIELD_VELVET_V3_UI_RIGHT_QUBE
    def_bool $(shields_list_contains,velvet_v3_ui_right_qube)

config SHIELD_VELVET_V3_UI_QUBE
    def_bool $(shields_list_contains,velvet_v3_ui_qube)

config SHIELD_VELVET_V3_UI_LEFT
    def_bool $(shields_list_contains,velvet_v3_ui_left)

config SHIELD_VELVET_V3_UI_RIGHT
    def_bool $(shields_list_contains,velvet_v3_ui_right)
```
